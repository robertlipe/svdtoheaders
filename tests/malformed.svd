# MalformedDevice register map
Vendor: TestVendor; Series: MalformedSVD; File version: 1.0
A malformed SVD for testing content validation.
CPU: CM0 r0p0, little endian, no MPU, no FPU, 2 interrupt priority bits
Registers are 32-bit, read-write, no defined reset value unless marked. A register's access mark holds for its fields unless they carry their own. Offsets are from the block's base; lines under a group give offsets from that group; [hi:lo] are bit positions; {n}, {i} and the like mark numbered series; 'fields as' and 'values as' point back to an identical list; <NAME> marks a mode.

## Memory map
0x40000000 ? size 0x1000 — A peripheral with a missing name.

## ? — A peripheral with a missing name.
Base 0x40000000
0x00 CTRL
